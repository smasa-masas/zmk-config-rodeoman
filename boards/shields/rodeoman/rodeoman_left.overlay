#include "rodeoman.dtsi"
#include <input/processors.dtsi>
#include <dt-bindings/zmk/input_transform.h>

&trackball_input_listener {
    status = "okay";
    device = <&trackball>;
    input-processors = <&zip_xy_to_scroll_mapper>
                     , <&zip_scroll_transform (INPUT_TRANSFORM_X_INVERT)>
                     ;
};
