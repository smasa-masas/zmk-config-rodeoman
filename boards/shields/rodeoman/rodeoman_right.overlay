#include "rodeoman.dtsi"
#include <input/processors.dtsi>
#include <dt-bindings/zmk/input_transform.h>

&trackball_split {
    device = <&trackball>;
};

&xiao_i2c {
    status = "okay";
    clock-frequency = <I2C_BITRATE_FAST>;

    trackball: trackball@a {
        compatible = "palette,az1uball";
        reg = <0x0A>;
        status = "okay";

        // トラックボールの分解能（速度）と、上下左右の反転設定
        input-processors = <&zip_xy_scaler 8 1>
                         , <&zip_xy_transform (INPUT_TRANSFORM_X_INVERT | INPUT_TRANSFORM_Y_INVERT)>
                         ;
    };
};
